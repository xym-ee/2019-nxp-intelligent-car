#include "system.h"

static void oled_data(uint8_t data);
static void oled_clear(void);



static void oled_init(void);


const oled_operations_t oled_ops = {
    .data = oled_data,
    .clear = oled_clear,

};


const oled_device_t oled = {
    .init = oled_init,
    .ops = &oled_ops,
};



//======================================
const uint8_t oeld_char_lib6x8[][6] =
{
  { 0x00, 0x00, 0x00, 0x00, 0x00, 0x00 },   // sp
  { 0x00, 0x00, 0x00, 0x2f, 0x00, 0x00 },   // !
  { 0x00, 0x00, 0x07, 0x00, 0x07, 0x00 },   // "
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  { 0x14, 0x14, 0x14, 0x14, 0x14, 0x14 }    // horiz lines
};


//开机画面
const uint8_t njustlogo[] = {
0x00,0x00,0x00,0x00,0x00,0x00,0x00,0x00,0x00,0x00,0x00,0x00,0x00,0x00,0x00,0x00,
0x00,0x00,0x00,0x00,0x00,0x00,0x00,0x00,0x00,0x00,0x00,0x00,0x00,0x00,0x00,0x00,
0x00,0x00,0x00,0x00,0x00,0x00,0x00,0x00,0x00,0x00,0x00,0x00,0x00,0x00,0x00,0x00,
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0x00,0x00,0x00,0x00,0x00,0x00,0x00,0x00,0x00,0x00,0x00,0x00,0x00,0x00,0x00,0x00,
};

static void oled_data(uint8_t data)
{
  unsigned char i = 8;
  LCD_DC(1);
  LCD_SCL(0);
  delayus(1);    
  while(i--)
  {
    if(data&0x80)
      LCD_SDA(1);
    else
      LCD_SDA(0);
    LCD_SCL(1); 
    delayus(1);          
    LCD_SCL(0);    
    data<<=1;    
  }
}

void LCD_WrCmd(unsigned char cmd)
{
  unsigned char i=8;
  LCD_DC(0);
  LCD_SCL(0);
  delayus(1);	  
  while(i--)
  {
    if(cmd&0x80)
      LCD_SDA(1);
    else
      LCD_SDA(0);
    LCD_SCL(1);
    delayus(1);	            
    LCD_SCL(0);    
    cmd<<=1;;   
  }
}

void LCD_Set_Pos(unsigned char x, unsigned char y)
{ 
  LCD_WrCmd(0xb0+y);
  LCD_WrCmd(((x&0xf0)>>4)|0x10);
  LCD_WrCmd((x&0x0f)); 
}

static void oled_clear(void)
{
  unsigned char y,x;	
  for(y=0;y<8;y++)
  {
    LCD_WrCmd(0xb0+y);
    LCD_WrCmd(0x01);
    LCD_WrCmd(0x10); 
    for(x=0;x<OLED_WIDTH;x++)
      oled.ops->data(0);
  }
}

static void oled_init(void)        
{ 
  //-----端口初始化----//
  CLOCK_EnableClock(kCLOCK_Iomuxc);           // IO口时钟使能

  IOMUXC_SetPinMux(LCD_DC_PINMUX, 0U);   //E11
  IOMUXC_SetPinMux(LCD_RST_PINMUX, 0U);   //E12
  IOMUXC_SetPinMux(LCD_SDA_PINMUX, 0U);   //D12
  IOMUXC_SetPinMux(LCD_SCL_PINMUX, 0U);   //D11
  
  IOMUXC_SetPinConfig(LCD_DC_PINMUX,0x10B0u); 
  IOMUXC_SetPinConfig(LCD_RST_PINMUX,0x10B0u);
  IOMUXC_SetPinConfig(LCD_SDA_PINMUX,0x10B0u);
  IOMUXC_SetPinConfig(LCD_SCL_PINMUX,0x10B0u);
  
  gpio_pin_config_t GPIO_Output_Config = {kGPIO_DigitalOutput, //GPIO为输出方向
                                          0,                   //低电平
                                          kGPIO_NoIntmode      //非中断模式
                                          };  
  GPIO_PinInit(LCD_DC_GPIO, LCD_DC_PIN, &GPIO_Output_Config);
  GPIO_PinInit(LCD_RST_GPIO, LCD_RST_PIN, &GPIO_Output_Config);      
  GPIO_PinInit(LCD_SDA_GPIO, LCD_SDA_PIN, &GPIO_Output_Config);  
  GPIO_PinInit(LCD_SCL_GPIO, LCD_SCL_PIN, &GPIO_Output_Config);      
 
  
  LCD_SCL(1);
  LCD_RST(0);
  delayms(50);
  LCD_RST(1);
  
  LCD_WrCmd(0xae);//--turn off oled panel
  LCD_WrCmd(0x00);//---set low column address
  LCD_WrCmd(0x10);//---set high column address
  LCD_WrCmd(0x40);//--set start line address  Set Mapping RAM Display Start Line (0x00~0x3F)
  LCD_WrCmd(0x81);//--set contrast control register
  LCD_WrCmd(0xcf); // Set SEG Output Current Brightness
  LCD_WrCmd(0xa1);//--Set SEG/Column Mapping     0xa0左右反置 0xa1正常
  LCD_WrCmd(0xc8);//Set COM/Row Scan Direction   0xc0上下反置 0xc8正常
  LCD_WrCmd(0xa6);//--set normal display
  LCD_WrCmd(0xa8);//--set multiplex ratio(1 to 64)
  LCD_WrCmd(0x3f);//--1/64 duty
  LCD_WrCmd(0xd3);//-set display offset	Shift Mapping RAM Counter (0x00~0x3F)
  LCD_WrCmd(0x00);//-not offset
  LCD_WrCmd(0xd5);//--set display clock divide ratio/oscillator frequency
  LCD_WrCmd(0x80);//--set divide ratio, Set Clock as 100 Frames/Sec
  LCD_WrCmd(0xd9);//--set pre-charge period
  LCD_WrCmd(0xf1);//Set Pre-Charge as 15 Clocks & Discharge as 1 Clock
  LCD_WrCmd(0xda);//--set com pins hardware configuration
  LCD_WrCmd(0x12);
  LCD_WrCmd(0xdb);//--set vcomh
  LCD_WrCmd(0x40);//Set VCOM Deselect Level
  LCD_WrCmd(0x20);//-Set Page Addressing Mode (0x00/0x01/0x02)
  LCD_WrCmd(0x02);//
  LCD_WrCmd(0x8d);//--set Charge Pump enable/disable
  LCD_WrCmd(0x14);//--set(0x10) disable
  LCD_WrCmd(0xa4);// Disable Entire Display On (0xa4/0xa5)
  LCD_WrCmd(0xa6);// Disable Inverse Display On (0xa6/a7) 
  LCD_WrCmd(0xaf);//--turn on oled panel
  oled.ops->clear();
  LCD_njust();
  delayms(800);
  oled.ops->clear();
  LCD_Set_Pos(0,0);  
} 

//==============================================================
//函数名：LCD_P6x8Str(unsigned char x,unsigned char y,unsigned char *p)
//功能描述：写入一组标准ASCII字符串
//参数：显示的位置（x,y），y为页范围0～7，要显示的字符串
//返回：无
//==============================================================
void LCD_P6x8Str(unsigned char x,unsigned char y,unsigned char ch[])
{
  unsigned char c=0,i=0,j=0;      
  while (ch[j]!='\0')
  {    
    c =ch[j]-32;
    if(x>126)
    {
      x=0;
      y++;
    }
    LCD_Set_Pos(x,y);    
    for(i=0;i<6;i++)     
      oled.ops->data(oeld_char_lib6x8[c][i]);  
    x+=6;
    j++;
  }
}

//==============================================================
//函数名： void LCD_PutPixel(unsigned char x,unsigned char y)
//功能描述：绘制一个点（x,y）
//参数：真实坐标值(x,y),x的范围0～127，y的范围0～64
//返回：无
//==============================================================
void LCD_PutPixel(unsigned char x,unsigned char y)
{
  unsigned char data1;  //data1当前点的数据 
  
  LCD_Set_Pos(x,(unsigned char)(y>>3)); 
  data1 =(unsigned char)(0x01<<(y%8)); 	
  LCD_WrCmd((unsigned char)(0xb0+(y>>3)));
  LCD_WrCmd((unsigned char)(((x&0xf0)>>4)|0x10));
  LCD_WrCmd((unsigned char)((x&0x0f)|0x00));
  oled.ops->data(data1); 	 	
}
//==============================================================
//函数名： void LCD_Rectangle(unsigned char x1,unsigned char y1,
//                   unsigned char x2,unsigned char y2,unsigned char color,unsigned char gif)
//功能描述：绘制一个实心矩形
//参数：左上角坐标（x1,y1）,右下角坐标（x2，y2）
//      其中x1、x2的范围0～127，y1，y2的范围0～63，即真实坐标值
//返回：无
//==============================================================
void LCD_Rectangle(unsigned char x1,unsigned char y1,unsigned char x2,unsigned char y2,unsigned char gif)
{
  unsigned char n; 
  
  LCD_Set_Pos(x1,y1>>3);
  for(n=x1;n<=x2;n++)
  {
    oled.ops->data(0x01<<(y1%8)); 			
    if(gif == 1) 	delayms(50);
  }  
  LCD_Set_Pos(x1,y2>>3);
  for(n=x1;n<=x2;n++)
  {
    oled.ops->data(0x01<<(y2%8)); 			
    if(gif == 1) 	delayms(5);
  }
  
}  

void LCD_njust(void)
{ 	
  unsigned int ii=0;
  unsigned char x,y;       
  
  for(y=0;y<8;y++)
  {
    LCD_Set_Pos(0,y);				
    for(x=0;x<128;x++)
    {      
      oled.ops->data(njustlogo[ii++]);	    	
    }
  }
}

void LCD_PrintFloat(unsigned char x,unsigned char y,float num)
{
  unsigned char tmp[6],i;
  tmp[5]=0;
  num *= 10;
  if(num>0)
  {
    tmp[0]='+';
    tmp[4]=(unsigned char)((int)num%10+0x30);
    tmp[3]=(unsigned char)((int)num/10%10+0x30);
    tmp[2]=(unsigned char)((int)num/100%10+0x30);
    tmp[1]=(unsigned char)((int)num/1000%10+0x30);
  }
  else
  {
    tmp[0]='-';
    num=-num;
    tmp[4]=(unsigned char)((int)num%10+0x30);
    tmp[3]=(unsigned char)((int)num/10%10+0x30);
    tmp[2]=(unsigned char)((int)num/100%10+0x30);
    tmp[1]=(unsigned char)((int)num/1000%10+0x30);
  }
  for(i=0;i<4;i++)
  {
    if(tmp[i]=='0')
      tmp[i]=' ';
    else
      break;
  }
  LCD_P6x8Str(x,y,tmp);
}

void LCD_Show_Frame94(void)
{
  LCD_Set_Pos(1,2);
  oled.ops->data(0xFF); 
  LCD_Set_Pos(1,3);
  oled.ops->data(0xFF); 
  LCD_Set_Pos(1,4);
  oled.ops->data(0xFF); 
  LCD_Set_Pos(1,5);
  oled.ops->data(0xFF);
  LCD_Set_Pos(1,6);
  oled.ops->data(0xFF);
  LCD_Set_Pos(1,7);
  oled.ops->data(0xFF);

  LCD_Set_Pos(96,2);
  oled.ops->data(0xFF); 
  LCD_Set_Pos(96,3);
  oled.ops->data(0xFF); 
  LCD_Set_Pos(96,4);
  oled.ops->data(0xFF); 
  LCD_Set_Pos(96,5);
  oled.ops->data(0xFF);
  LCD_Set_Pos(96,6);
  oled.ops->data(0xFF);
  LCD_Set_Pos(96,7);
  oled.ops->data(0xFF);
}

